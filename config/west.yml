## config/west.yml
```yaml
manifest:
  remotes:
    - name: zmkfirmware
      url-base: https://github.com/zmkfirmware
    - name: sgomezsal
      url-base: https://github.com/sgomezsal
  projects:
    - name: zmk
      remote: zmkfirmware
      revision: v0.3
      import: app/west.yml
    - name: urchin-peripheral-animation
      remote: sgomezsal
      revision: main
  self:
    path: config
```
